#include "wled.h"
#include <LedControl.h>

// AI: below section was generated by an AI
/*
 * astroBeat control panel for the hulaweenAstronaut project (LilyGO T-ETH-Lite S3).
 *
 * - Buttons 1-3 start Fire / Ripple / Noise; pressing the running pattern's button again blacks out.
 * - Button 4 toggles audio reactivity (AR); hold it and turn the pot to set the AR depth.
 * - Toggles T1-T4 form a one-hot bitfield: with exactly one engaged, the pot adjusts
 *   brightness / speed / intensity / Fire colour mode.
 * - MAX7219 8-digit display: digits 7-4 = program field, digits 3-0 = value field.
 * - Also holds the unused on-board W5500 Ethernet chip in reset.
 *
 * All active segments get the same settings, so with one segment per output the strips mirror each other.
 */

#ifndef ASTRO_BTN_PINS
  #define ASTRO_BTN_PINS 2, 3, 4, 5
#endif
#ifndef ASTRO_TOGGLE_PINS
  #define ASTRO_TOGGLE_PINS 6, 7, 8, 21
#endif
#ifndef ASTRO_LIGHT_PINS
  #define ASTRO_LIGHT_PINS 38, 39, 40, 41
#endif
#ifndef ASTRO_POT_PIN
  #define ASTRO_POT_PIN 1
#endif
#ifndef ASTRO_MAX7219_PINS
  #define ASTRO_MAX7219_PINS 47, 48, 45   // DIN, CLK, CS
#endif
#ifndef W5500_RST_PIN
  #define W5500_RST_PIN 14
#endif

static constexpr uint8_t  NUM_CTRL       = 4;
static constexpr uint32_t DEBOUNCE_MS    = 20;
static constexpr uint32_t POT_PERIOD_MS  = 20;
static constexpr int      POT_HYST       = 40;     // 12-bit ADC counts
static constexpr int      POT_MAX        = 4095;
static constexpr uint32_t BLINK_MS       = 1000;
static constexpr uint32_t AR_PERIOD_MS   = 20;
static constexpr uint32_t HUE_PERIOD_MS  = 16;
static constexpr int      DISP_DASHES    = -1;     // display cache code for "----"
static constexpr int      DISP_UNSET     = -2;

static constexpr uint8_t  PROG_FX[]      = { FX_MODE_FIRE_2012, FX_MODE_RIPPLE_RAINBOW, FX_MODE_NOISEPAL };
static constexpr uint8_t  NUM_PROGS      = sizeof(PROG_FX);

// Fire colour modes, starting values taken from the original Pro Micro firmware
enum FireMode : uint8_t { FireNormal = 0, FireMdma, FireFreakOut, NUM_FIRE_MODES };
static constexpr uint8_t  FIRE_PALETTE[] = { 35, 4, 4 };   // "Fire", "* Color Gradient", "* Color Gradient"
static constexpr uint8_t  FIRE_COOLING   = 55;
static constexpr uint8_t  FIRE_SPARK[]   = { 100, 160, 192 };
static constexpr uint8_t  FIRE_BRI[]     = { 96, 192, 255 };
static constexpr uint8_t  HUE_PURPLE     = 213;
static constexpr uint8_t  HUE_AQUA       = 128;

// one debounced digital input (wired to GND, internal pull-up)
struct DebouncedInput {
  int8_t   pin;
  bool     stable;      // true = released / off
  bool     lastRaw;
  uint32_t changedAt;
};

class AstroBeatUsermod : public Usermod {
  private:
    static constexpr int8_t btnPins[NUM_CTRL]    = { ASTRO_BTN_PINS };
    static constexpr int8_t togglePins[NUM_CTRL] = { ASTRO_TOGGLE_PINS };
    static constexpr int8_t lightPins[NUM_CTRL]  = { ASTRO_LIGHT_PINS };
    static constexpr int8_t dispPins[3]          = { ASTRO_MAX7219_PINS };

    bool enabled = true;
    bool initDone = false;
    LedControl *lc = nullptr;

    DebouncedInput buttons[NUM_CTRL];
    DebouncedInput toggles[NUM_CTRL];

    uint8_t program = 0;              // 0 = stopped, 1..NUM_PROGS = running pattern
    uint8_t fireMode = FireNormal;
    int     potRaw = -1000;           // last accepted 12-bit reading (forces first reading through)
    uint8_t potValue = 0;
    uint32_t lastPotRead = 0;

    bool    arOn = false;
    uint8_t arDepth = 128;
    uint8_t baseIntensity = 128;      // intensity set by the user; AR modulates on top of it
    float   pitchHue = 0.0f;
    uint32_t lastArUpdate = 0;

    bool    btn4Held = false;
    bool    btn4PotUsed = false;

    uint8_t  freakHue = 0;
    uint32_t lastHueUpdate = 0;

    int dispValue = DISP_UNSET;
    int dispProgram = DISP_UNSET;

    static const char _name[];
    static const char _enabled[];
    static const char _arDepth[];

    static void initInput(DebouncedInput &in, int8_t pin) {
      in.pin = pin;
      pinMode(pin, INPUT_PULLUP);
      in.stable = in.lastRaw = digitalRead(pin);
      in.changedAt = millis();
    }

    // returns true when the debounced state changed
    static bool updateInput(DebouncedInput &in, uint32_t now) {
      bool raw = digitalRead(in.pin);
      if (raw != in.lastRaw) {
        in.lastRaw = raw;
        in.changedAt = now;
      } else if (raw != in.stable && now - in.changedAt >= DEBOUNCE_MS) {
        in.stable = raw;
        return true;
      }
      return false;
    }

    template<typename F> static void forEachSegment(F fn) {
      for (unsigned i = 0; i < strip.getSegmentsNum(); i++) {
        Segment &seg = strip.getSegment(i);
        if (seg.isActive()) fn(seg);
      }
    }

    static Segment &firstActiveSegment() {
      for (unsigned i = 0; i < strip.getSegmentsNum(); i++) {
        if (strip.getSegment(i).isActive()) return strip.getSegment(i);
      }
      return strip.getMainSegment();
    }

    uint8_t toggleBits() const {
      uint8_t bits = 0;
      for (unsigned i = 0; i < NUM_CTRL; i++) if (!toggles[i].stable) bits |= 1 << i;
      return bits;
    }

    // index of the single engaged toggle, or -1 if zero or several are engaged
    int8_t singleToggle() const {
      uint8_t bits = toggleBits();
      if (bits == 0 || (bits & (bits - 1))) return -1;
      return __builtin_ctz(bits);
    }

    // set the colours of the Color Gradient palette (index 0 = colors[2], top = colors[0]), without transitions
    static void setGradient(uint32_t top, uint32_t mid) {
      forEachSegment([&](Segment &seg) {
        seg.colors[0] = top;
        seg.colors[1] = mid;
        seg.colors[2] = BLACK;
      });
    }

    static uint32_t hsv(uint8_t h, uint8_t s, uint8_t v) {
      CRGB c = CHSV(h, s, v);
      return RGBW32(c.r, c.g, c.b, 0);
    }

    void applyFireColours() {
      if (fireMode == FireMdma)          setGradient(RGBW32(0, 255, 255, 0), RGBW32(128, 0, 128, 0));   // aqua, purple
      else if (fireMode == FireFreakOut) setGradient(hsv(freakHue, 128, 255), hsv(freakHue, 255, 192));
    }

    // load a Fire colour mode's palette, cooling and spark rate; optionally its brightness
    void applyFireMode(bool loadBri) {
      forEachSegment([&](Segment &seg) {
        seg.setPalette(FIRE_PALETTE[fireMode]);
        seg.speed = FIRE_COOLING;
        seg.intensity = FIRE_SPARK[fireMode];
      });
      applyFireColours();
      baseIntensity = FIRE_SPARK[fireMode];
      if (loadBri) bri = FIRE_BRI[fireMode];
    }

    void startProgram(uint8_t p) {
      program = p;
      forEachSegment([&](Segment &seg) { seg.setMode(PROG_FX[p - 1], true); });
      if (p == 1) applyFireMode(false);
      else baseIntensity = firstActiveSegment().intensity;
      if (bri == 0) bri = briLast ? briLast : 128;
      stateChanged = true;
      stateUpdated(CALL_MODE_BUTTON);
    }

    void stopProgram() {
      restoreFromAr();
      program = 0;
      if (bri) briLast = bri;
      bri = 0;
      stateUpdated(CALL_MODE_BUTTON);
    }

    // undo AR modulation: base intensity and the mode's normal colours
    void restoreFromAr() {
      if (!arOn || !program) return;
      forEachSegment([&](Segment &seg) { seg.intensity = baseIntensity; });
      if (program == 1) applyFireColours();
      stateChanged = true;
    }

    um_data_t *audioData() {
      um_data_t *um = nullptr;
      if (!UsermodManager::getUMData(&um, USERMOD_ID_AUDIOREACTIVE) || !um) return nullptr;
      return um;
    }

    void toggleAr() {
      if (arOn) {
        restoreFromAr();
        arOn = false;
        stateUpdated(CALL_MODE_BUTTON);
      } else if (audioData()) {
        if (program) baseIntensity = firstActiveSegment().intensity;
        arOn = true;
      } else {
        DEBUG_PRINTLN(F("astroBeat: audioreactive not available"));
      }
    }

    // modulate intensity by volume and, in Fire MDMA / FREAK OUT, colour by pitch
    void updateAr() {
      um_data_t *um = audioData();
      if (!um) return;
      float volume = *(float *)um->u_data[0];   // volumeSmth, 0..255
      float peakHz = *(float *)um->u_data[4];   // FFT_MajorPeak
      volume = constrain(volume, 0.0f, 255.0f);

      uint8_t level = baseIntensity + (uint8_t)((255 - baseIntensity) * (volume / 255.0f) * (arDepth / 255.0f));
      forEachSegment([&](Segment &seg) { seg.intensity = level; });

      if (program != 1 || fireMode == FireNormal) return;
      if (volume > 1.0f && peakHz > 0.0f) {
        // log mapping of 80 Hz..5 kHz onto hue 0..255, then a 1st-order low-pass against jumps
        constexpr float F_LO = 80.0f, F_HI = 5000.0f;
        float f = constrain(peakHz, F_LO, F_HI);
        float target = 255.0f * logf(f / F_LO) / logf(F_HI / F_LO);
        pitchHue += (target - pitchHue) * 0.2f;
      }
      uint8_t hue = (uint8_t)pitchHue;
      if (fireMode == FireMdma) {
        uint8_t shift = (hue * arDepth) / 255;
        setGradient(hsv(HUE_AQUA + shift, 255, 255), hsv(HUE_PURPLE + shift, 255, 128));
      } else {
        setGradient(hsv(hue, 128, 255), hsv(hue, 255, 192));
      }
    }

    // read the pot; returns true when its mapped 0..255 value changed
    bool readPot(uint32_t now) {
      if (now - lastPotRead < POT_PERIOD_MS) return false;
      lastPotRead = now;
      int raw = 0;
      for (unsigned i = 0; i < 4; i++) raw += analogRead(ASTRO_POT_PIN);
      raw /= 4;
      if (abs(raw - potRaw) <= POT_HYST) return false;
      potRaw = raw;
      // the hysteresis band is cut off at both ends so 0 and 255 stay reachable
      uint8_t v = constrain(map(raw, POT_HYST, POT_MAX - POT_HYST, 0, 255), 0, 255);
      if (v == potValue) return false;
      potValue = v;
      return true;
    }

    void handlePot() {
      if (btn4Held) {
        arDepth = potValue;
        btn4PotUsed = true;
        return;
      }
      if (!program) return;
      switch (singleToggle()) {
        case 0:
          bri = max<uint8_t>(potValue, 1);   // 0 would look like "stopped"
          stateUpdated(CALL_MODE_BUTTON);
          break;
        case 1:
          forEachSegment([&](Segment &seg) { seg.speed = potValue; });
          stateChanged = true;
          stateUpdated(CALL_MODE_BUTTON);
          break;
        case 2:
          baseIntensity = potValue;
          if (!arOn) {
            forEachSegment([&](Segment &seg) { seg.intensity = potValue; });
            stateChanged = true;
            stateUpdated(CALL_MODE_BUTTON);
          }
          break;
        case 3:
          if (program == 1) {
            uint8_t mode = min<uint8_t>(potValue / 85, NUM_FIRE_MODES - 1);
            if (mode != fireMode) {
              fireMode = mode;
              applyFireMode(true);
              stateChanged = true;
              stateUpdated(CALL_MODE_BUTTON);
            }
          }
          break;
        default:
          break;
      }
    }

    void handleButton(uint8_t idx, bool pressed) {
      if (idx == 3) {
        if (pressed) {
          btn4Held = true;
          btn4PotUsed = false;
        } else {
          if (!btn4PotUsed) toggleAr();
          btn4Held = false;
        }
        return;
      }
      if (!pressed) return;
      if (program == idx + 1) stopProgram();
      else {
        restoreFromAr();
        startProgram(idx + 1);
      }
    }

    int wantedValueField() {
      if (btn4Held) return arDepth;
      if (!program) return DISP_DASHES;
      switch (singleToggle()) {
        case 0:  return bri;
        case 1:  return firstActiveSegment().speed;
        case 2:  return arOn ? baseIntensity : firstActiveSegment().intensity;
        case 3:  return program == 1 ? fireMode + 1 : DISP_DASHES;
        default: return DISP_DASHES;
      }
    }

    // write a 4-digit field starting at digit `first` (rightmost); leading zeros are blanked
    void showField(uint8_t first, int value) {
      for (unsigned d = 0; d < 4; d++) {
        if (value == DISP_DASHES)               lc->setChar(0, first + d, '-', false);
        else if (d > 0 && value < decimalPlace(d))     lc->setChar(0, first + d, ' ', false);
        else                                    lc->setDigit(0, first + d, (value / decimalPlace(d)) % 10, false);
      }
    }

    static int decimalPlace(unsigned d) { return d == 0 ? 1 : d == 1 ? 10 : d == 2 ? 100 : 1000; }

    void updateDisplay() {
      int value = wantedValueField();
      if (value != dispValue) {
        showField(0, value);
        dispValue = value;
      }
      int prog = program ? program : DISP_DASHES;
      if (prog != dispProgram) {
        if (program) {
          lc->setDigit(0, 4, program, false);
          lc->setChar(0, 5, ' ', false);
          lc->setChar(0, 6, ' ', false);
          lc->setChar(0, 7, 'P', false);
        } else {
          showField(4, DISP_DASHES);
        }
        dispProgram = prog;
      }
    }

    void updateLights(uint32_t now) {
      bool blinkOn = (now / BLINK_MS) & 1;
      for (unsigned i = 0; i < NUM_PROGS; i++) digitalWrite(lightPins[i], program == i + 1 && blinkOn);
      digitalWrite(lightPins[3], arOn);
    }

  public:
    void setup() override {
      managed_pin_type pins[] = {
        { btnPins[0], false }, { btnPins[1], false }, { btnPins[2], false }, { btnPins[3], false },
        { togglePins[0], false }, { togglePins[1], false }, { togglePins[2], false }, { togglePins[3], false },
        { lightPins[0], true }, { lightPins[1], true }, { lightPins[2], true }, { lightPins[3], true },
        { ASTRO_POT_PIN, false },
        { dispPins[0], true }, { dispPins[1], true }, { dispPins[2], true },
        { W5500_RST_PIN, true },
      };
      if (!PinManager::allocateMultiplePins(pins, sizeof(pins) / sizeof(pins[0]), PinOwner::UM_Unspecified)) {
        DEBUG_PRINTLN(F("astroBeat: pin allocation failed, usermod disabled"));
        enabled = false;
        return;
      }

      pinMode(W5500_RST_PIN, OUTPUT);
      digitalWrite(W5500_RST_PIN, LOW);

      for (unsigned i = 0; i < NUM_CTRL; i++) {
        initInput(buttons[i], btnPins[i]);
        initInput(toggles[i], togglePins[i]);
        pinMode(lightPins[i], OUTPUT);
        digitalWrite(lightPins[i], LOW);
      }
      pinMode(ASTRO_POT_PIN, INPUT);

      lc = new LedControl(dispPins[0], dispPins[1], dispPins[2], 1);
      lc->shutdown(0, false);
      lc->setIntensity(0, 8);
      lc->clearDisplay(0);

      readPot(POT_PERIOD_MS);   // prime the pot so the boot position doesn't count as a move
      initDone = true;
    }

    void loop() override {
      if (!enabled || !initDone) return;
      uint32_t now = millis();

      for (unsigned i = 0; i < NUM_CTRL; i++) {
        if (updateInput(buttons[i], now)) handleButton(i, !buttons[i].stable);
        updateInput(toggles[i], now);
      }

      // WLED turned off from elsewhere (web UI, sync): show the panel as stopped
      if (program && bri == 0) {
        restoreFromAr();
        program = 0;
      }

      if (readPot(now)) handlePot();

      if (program == 1 && fireMode == FireFreakOut && !arOn && now - lastHueUpdate >= HUE_PERIOD_MS) {
        lastHueUpdate = now;
        freakHue++;
        applyFireColours();
      }

      if (arOn && program && now - lastArUpdate >= AR_PERIOD_MS) {
        lastArUpdate = now;
        updateAr();
      }

      updateDisplay();
      updateLights(now);
    }

    void addToConfig(JsonObject &root) override {
      JsonObject top = root.createNestedObject(FPSTR(_name));
      top[FPSTR(_enabled)] = enabled;
      top[FPSTR(_arDepth)] = arDepth;
    }

    bool readFromConfig(JsonObject &root) override {
      JsonObject top = root[FPSTR(_name)];
      bool configComplete = !top.isNull();
      configComplete &= getJsonValue(top[FPSTR(_enabled)], enabled, true);
      configComplete &= getJsonValue(top[FPSTR(_arDepth)], arDepth, (uint8_t)128);
      return configComplete;
    }
};


const char AstroBeatUsermod::_name[]    PROGMEM = "astroBeat";
const char AstroBeatUsermod::_enabled[] PROGMEM = "enabled";
const char AstroBeatUsermod::_arDepth[] PROGMEM = "arDepth";

static AstroBeatUsermod astroBeat;
REGISTER_USERMOD(astroBeat);
// AI: end
